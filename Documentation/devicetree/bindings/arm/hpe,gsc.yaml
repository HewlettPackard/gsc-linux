## Documentation/devicetree/bindings/arm/hpe,gsc.yaml
```yaml
# SPDX-License-Identifier: (GPL-2.0-only OR BSD-2-Clause)
%YAML 1.2
---
$id: http://devicetree.org/schemas/arm/hpe,gxp.yaml#
$schema: http://devicetree.org/meta-schemas/core.yaml#

title: HPE BMC GSC platforms

maintainers:
  - Nick Hawkins <nick.hawkins@hpe.com>
  - Jean-Marie Verdun <verdun@hpe.com>

properties:
  compatible:
    oneOf:
      - description: GSC Based Boards
        items:
          - enum:
              - hpe,gsc-dl360gen12
          - const: hpe,gsc

required:
  - compatible

additionalProperties: true

...
```

## Documentation/devicetree/bindings/hwmon/hpe,gxp-coretemp.yaml
```yaml
# SPDX-License-Identifier: (GPL-2.0-only OR BSD-2-Clause)
%YAML 1.2
---

$id: http://devicetree.org/schemas/hwmon/hpe,gxp-coretemp.yaml#
$schema: http://devicetree.org/meta-schemas/core.yaml#

title: HPE GXP/GSC Core Temp Sensor

maintainers:
  - Nick Hawkins <nick.hawkins@hpe.com>

description: |
  The GXP and GSC Chips have a built in sensor for monitoring the temperature of the
  part which allows for thermal control and notification.

properties:
  compatible:
    const: hpe,gxp-coretemp

  reg:
    maxItems: 1

required:
  - compatible
  - reg

additionalProperties: false

examples:
  - |
    coretemp@c0000130 {
        compatible = "hpe,gxp-coretemp";
        reg = <0xc0000130 0x8>;
    };
```

## Documentation/devicetree/bindings/hwmon/hpe,gxp-fan-ctrl-trinity.yaml
```yaml
# SPDX-License-Identifier: (GPL-2.0-only OR BSD-2-Clause)
%YAML 1.2
---

$id: http://devicetree.org/schemas/hwmon/hpe,gxp-fan-ctrl-trinity.yaml#
$schema: http://devicetree.org/meta-schemas/core.yaml#

title: HPE GXP Fan Controller

maintainers:
  - Nick Hawkins <nick.hawkins@hpe.com>

description: |
  The HPE GXP fan controller controls the fans through an external CPLD
  device that connects to the fans.

properties:
  compatible:
    const: hpe,gxp-fan-ctrl-trinity

  reg:
    maxItems: 1

  hpe,xreg:
    $ref: /schemas/types.yaml#/definitions/phandle
    description:
      Phandle to the xregister interface where fan information is available.

  hpe,fn2reg:
    $ref: /schemas/types.yaml#/definitions/phandle
    description:
      Phandle to the fn2 interface where power information is available.

required:
  - compatible
  - reg

additionalProperties: false

examples:
  - |
    fan-controller@c0000c00 {
        compatible = "hpe,gxp-fan-ctrl-trinity";
        reg = <0xc0000c00 0x200>;
        hpe,xreg = <&sysreg_system_controller>;
        hpe,fn2reg = <&sysreg_system_controller2>;
    };
```

## Documentation/devicetree/bindings/i3c/hpe,i3c-master.yaml
```yaml
# SPDX-License-Identifier: (GPL-2.0-only OR BSD-2-Clause)
%YAML 1.2
---
$id: http://devicetree.org/schemas/i3c/hpe,i3c-master.yaml#
$schema: http://devicetree.org/meta-schemas/core.yaml#

title: HPE GSC I3C master block

maintainers:
  - Nick Hawkins <nick.hawkins@hpe.com>

allOf:
  - $ref: i3c.yaml#

properties:
  compatible:
    const: hpe,i3c-master

  reg:
    maxItems: 1

  interrupts:
    maxItems: 1

required:
  - compatible
  - reg
  - interrupts

unevaluatedProperties: false

examples:
  - |
    i3c-master@d040000 {
        compatible = "hpe,i3c-master";
        interrupts = <3 0>;
        reg = <0x0d040000 0x1000>;
        #address-cells = <3>;
        #size-cells = <0>;
        i2c-scl-hz = <100000>;

        eeprom@57{
            compatible = "atmel,24c01";
            reg = <0x57 0x0 0x10>;
            pagesize = <0x8>;
        };
    };
...
```

## Documentation/devicetree/bindings/ipmi/hpe,gxp-kcs-bmc.yaml
```yaml
# SPDX-License-Identifier: (GPL-2.0-only OR BSD-2-Clause)
%YAML 1.2
---
$id: http://devicetree.org/schemas/ipmi/hpe,gxp-kcs-bmc.yaml#
$schema: http://devicetree.org/meta-schemas/core.yaml#

title: GXP BMC Devices

maintainers:
  - Nick Hawkins <nick.hawkins@hpe.com>

description: |
  The HPE BMC SoCs typically use the Keyboard-Controller-Style (KCS)
  interfaces on the LPC bus for in-band IPMI communication with their host.

properties:
  compatible:
    const: hpe,gxp-kcs-bmc

  reg:
    items:
      - description: Base register
      - description: Config register

  reg-names:
    items:
      - const: base
      - const: cfg

  interrupts:
    maxItems: 2

  kcs_chan:
    deprecated: true
    $ref: '/schemas/types.yaml#/definitions/uint32'
    description: The LPC channel number in the controller

required:
  - compatible
  - reg
  - reg-names
  - interrupts

additionalProperties: false

examples:
  - |
    kcs@80fd0400 {
        compatible = "hpe,gxp-kcs-bmc";
        reg = <0x80fd0400 0x100>, <0x80fc0400 0x100>;
        reg-names = "base", "cfg";
        interrupts = <8>, <9>;
        kcs_chan = <1>;
    };
```

## Documentation/devicetree/bindings/net/ncsi.yaml
```yaml
# SPDX-License-Identifier: (GPL-2.0-only OR BSD-2-Clause)
%YAML 1.2

$id: http://devicetree.org/schemas/net/ncsi.yaml#
$schema: http://devicetree.org/meta-schemas/core.yaml#

title: Network Controller Sideband Interface (NCSI)

maintainers:
  - Samuel Mendoza-Jonas <sam@mendozajonas.com>

description: |
  Bindings for the Network Controller Sideband Interface (NCSI) driver

properties:
  ncsi,vlan-mode:
    description: VLAN mode used on the NCSI device.
    $ref: /schemas/types.yaml#/definitions/uint32
    enum: [0, 1, 2, 3]

examples:
  - |
    #include <dt-bindings/net/ncsi.h>

    mac0: ethernet@1e660000 {
      compatible = "aspeed,ast2600-mac", "faraday,ftgmac100";
      reg = <0x1e660000 0x180>;
      status = "okay";

      use-ncsi;
      ncsi,vlan-mode = <NCSI_VLAN_MODE_ANY>;
    };

...
```

## Documentation/devicetree/bindings/rtc/hpe,gsc-rtc.yaml
```yaml
# SPDX-License-Identifier: (GPL-2.0-only OR BSD-2-Clause)
%YAML 1.2
---
$id: http://devicetree.org/schemas/rtc/hpe,gsc-rtc.yaml#
$schema: http://devicetree.org/meta-schemas/core.yaml#

title: HPE GSC RTC Controller

maintainers:
  - Nick Hawkins <nick.hawkins@hpe.com>

properties:
  compatible:
    const: hpe,gsc-rtc

  reg:
    maxItems: 1

  interrupts:
    maxItems: 1

required:
  - compatible
  - reg
  - interrupts

additionalProperties: false

examples:
  - |
    rtc@c0000600 {
        compatible = "hpe,gsc-rtc";
        reg = <0xc0000600 0x100>;
        interrupts = <9>;
    };
```

## Documentation/devicetree/bindings/soc/hpe/generic-uio.yaml
```yaml
# SPDX-License-Identifier: (GPL-2.0-only OR BSD-2-Clause)
%YAML 1.2
---
$id: http://devicetree.org/schemas/soc/hpe/generic-uio.yaml#
$schema: http://devicetree.org/meta-schemas/core.yaml#

title: HPE Generic UIO

maintainers:
  - Nick Hawkins <nick.hawkins@hpe.com>

description:
  Allows register access in OS. DO NOT COMMIT this is to work
  around checkpatch.pl warnings.

properties:
  compatible:
    const: hpe,gsc-se

  reg:
    maxItems: 1

  reg-names:
    maxItems: 1

  interrupts:
    maxItems: 1

required:
  - compatible
  - reg
  - interrupts

additionalProperties: false

examples:
  - |
    dptxreg@c00020000 {
        compatible = "generic-uio";
        reg = <0xcefd0000 0x10000>;
        interrupts = <0 3 4>;
    };
```

## Documentation/devicetree/bindings/soc/hpe/hpe,gsc-se.yaml
```yaml
# SPDX-License-Identifier: (GPL-2.0-only OR BSD-2-Clause)
%YAML 1.2
---
$id: http://devicetree.org/schemas/soc/hpe/hpe,gsc-se.yaml#
$schema: http://devicetree.org/meta-schemas/core.yaml#

title: HPE GSC Security Enclave Interface

maintainers:
  - Nick Hawkins <nick.hawkins@hpe.com>

description:
  The GSC soc houses a separate chip called Security Enclave. This
  interface allows interruptable communication with that chip.

properties:
  compatible:
    const: hpe,gsc-se

  reg:
    maxItems: 1

  interrupts:
    maxItems: 1

required:
  - compatible
  - reg
  - interrupts

additionalProperties: false

examples:
  - |
    enclave@cefd0000 {
        compatible = "hpe,gsc-se";
        reg = <0xcefd0000 0x10000>;
        interrupts = <0 3 4>;
    };
```

## Documentation/devicetree/bindings/soc/hpe/hpe,gxp-chif.yaml
```yaml
# SPDX-License-Identifier: (GPL-2.0-only OR BSD-2-Clause)
%YAML 1.2
---
$id: http://devicetree.org/schemas/soc/hpe/hpe,gxp-chif.yaml#
$schema: http://devicetree.org/meta-schemas/core.yaml#

title: HPE CHIF Non Blocking Channel Interface

maintainers:
  - Nick Hawkins <nick.hawkins@hpe.com>

description:
  A shared memory interface between OS and SOC that allows for communication.

properties:
  compatible:
    const: hpe,gxp-chif

  interrupts:
    maxItems: 1

required:
  - compatible
  - interrupts

additionalProperties: false

examples:
  - |
    chif {
        compatible = "hpe,gxp-chif";
        interrupts = <0 3 4>;
    };
```

## Documentation/devicetree/bindings/usb/hpe,gxp-hub.yaml
```yaml
# SPDX-License-Identifier: (GPL-2.0-only OR BSD-2-Clause)
%YAML 1.2
---
$id: http://devicetree.org/schemas/usb/hpe,gxp-udcg.yaml#
$schema: http://devicetree.org/meta-schemas/core.yaml#

title: HPE GXP USB HUB controller

maintainers:
  - Nick Hawkins <nick.hawkins@hpe.com>
  - Richard Yu <richard.yu@hpe.com>

description:
  The HPE GXP USB HUB Controller implements 1 set of USB
  register and several sets of device and endpoint registers to support
  the HUB's downstream USB devices.

properties:
  compatible:
    enum:
      - hpe,gxp-hub

  reg:
    items:
      - description: GXP hub (gxphub) controller register set
      - description: Several sets of Device and Endpoint registers to support
                     the HUB's downstream USB devices.

  reg-names:
    items:
      - const: gxphub
      - const: udc

  interrupts:
    maxItems: 1

required:
  - compatible
  - reg
  - reg-names
  - interrupts

additionalProperties: false

examples:
  - |
    usb-hub@80400800 {
        compatible = "hpe,gxp-hub";
        reg = <0x80400800 0x0200>, <0x80401000 0x8000>;
        reg-names = "gxphub", "udc";
        interrupts = <13>;
        interrupt-parent = <&vic1>;
    };
```

## drivers/gpu/drm/dvrdp/Kconfig
```kconfig
config DISPLAY_PORT_DRIVER
	bool "Display Port Driver For Sanjac"
	depends on ARCH_HPE_GSC
	help
	  Say yes here to add support for the display port driver
	  for sanjac
```

## drivers/media/platform/hpe/Kconfig
```kconfig
# SPDX-License-Identifier: GPL-2.0-only

comment "GXP media platform drivers"

config VIDEO_GXP
	tristate "GXP Digital Video Interface driver"
	depends on VIDEO_DEV
	depends on V4L_PLATFORM_DRIVERS
	depends on MEDIA_SUPPORT
	depends on MEDIA_PLATFORM_SUPPORT
	depends on MEDIA_CAMERA_SUPPORT
	select VIDEOBUF2_DMA_CONTIG
	select V4L_MEM2MEM_DRIVERS
	help
	  Support for the GXP Digital Video Interface.

config VIDEO_GXP_THUMBNAIL
	tristate "GXP THUMBNAIL Video Engine driver"
	depends on VIDEO_DEV
	depends on V4L_PLATFORM_DRIVERS
	depends on MEDIA_SUPPORT
	depends on MEDIA_PLATFORM_SUPPORT
	depends on MEDIA_CAMERA_SUPPORT
	select VIDEOBUF2_DMA_CONTIG
	select V4L_MEM2MEM_DRIVERS
	help
	  Support for the GXP THUMBNAILVideo Engine (VE) embedded in the GXP SOC. The VE can capture video data
	  from digital sources.
```

## drivers/misc/hpe/Kconfig
```kconfig
config GSC_COMMON_PHY
	bool "Common Phy Support"
	depends on ARCH_HPE_GSC
	help
	  Say yes here to add support for the GSC Common Phy driver
	  used commonly for both Ethernet and DisplayPort
```

## drivers/soc/hpe/Kconfig
```kconfig
config SOC_VENDOR_HPE
	bool "HPE SoC drivers"
	default y
	depends on ARCH_HPE

if SOC_VENDOR_HPE

config HPE_GXP_SOCLIB
	bool
	default n

config HPE_GXP_FIX_GEN11_ME_ISSUE
	bool "GXP ME Workaround on SaphireRapids processors"
	depends on ARCH_HPE_GXP
	help
	  Say yes here to work around ME issues on Saphire rapids
	  processors on Virtual Power Button Press

config HPE_GXP_SROM
	bool "GXP SROM Support"
	depends on ARCH_HPE_GXP || ARCH_HPE_GSC
	select HPE_GXP_SOCLIB
	select MFD_CORE
	help
	  Say yes here to add support for SROM Configuration.

config HPE_GXP_CHIF
	bool "GXP CHIF Support"
	depends on ARCH_HPE_GXP || ARCH_HPE_GSC
	select HPE_GXP_SOCLIB
	help
	  Say yes here to add support for CHIF

config HPE_GXP_SE
	bool "GXP SE Support"
	depends on ARCH_HPE_GXP || ARCH_HPE_GSC
	select HPE_GXP_SOCLIB
	help
	  Say yes here to add support for SE


config HPE_GXP_GPIO_MISC
	bool "GXP MISC GPIO Support"
	depends on ARCH_HPE_GXP || ARCH_HPE_GSC
	select HPE_GXP_SOCLIB
	help
	  Say yes here to add support for GPIO MISC.

config HPE_GXP_KW_REG
	bool "Enable sysfs interface for KW only reg."
	depends on ARCH_HPE_GSC
	help
	  Say yes here to add sysfs interfaces for KW only reg to write
	  from userspace.

config HPE_GSC_POWEROFF
	bool "Enable notification for kernel restart handler"
	depends on ARCH_HPE_GSC
	help
	  Say yes here to register for kernel restart notification

config HPE_GXP_CPU
	bool "GXP CPU Presence GPIO driver"
	depends on ARCH_HPE_GXP
	select HPE_GXP_SOCLIB
	help
	  Say yes here to add support for CPU Presence

config HPE_GXP_VIRT_EEPROM
	bool "GXP Virtual EEPROM Support"
	depends on ARCH_HPE_GXP
	depends on I2C
	select HPE_GXP_SOCLIB
	help
	  Say yes here to add support for the Virtual EEPROM.

config HPE_GXP_DBG
	bool "GXP host debug post message support"
	depends on ARCH_HPE_GXP
	select HPE_GXP_SOCLIB
	help
	  Say yes here to add support for host debug driver support.

config HPE_GXP_RELEASE
	bool "GXP release build support"
	select HPE_GXP_SOCLIB
	default n
	help
	  This flag removes unwanted implementaions
	  or features
	  for release kernel
	  Say yes for release kernel.
	  It removes unused Kernel write only register sysfs interfaces.
endif
```

## drivers/ubm/Kconfig
```kconfig
# SPDX-License-Identifier: GPL-2.0-only
#
# Hardware monitoring chip drivers configuration
#

menuconfig UBM
	tristate "Universal Storage Backplane Management support"
	depends on HAS_IOMEM
	default y
	help
		Enable UBM support

config UBM4
        tristate "UBM 4 driver"
	depends on I2C
	default n
        help
          If you say yes here you get support for ubm 4 function
```

## security/ztcp/Kconfig
```kconfig
# SPDX-License-Identifier: GPL-2.0-only

config SECURITY_ZTCP
	bool "Zero Trust Container Platform"
	depends on SECURITY
	select SECURITYFS
	select SECURITY_PATH
	default n
	help
		Zero Trust Container Platform
```
